/*
 * Copyright (C) 2015 Freescale Semiconductor, Inc.
 *
 * This program is free software; you can redistribute it and/or modify
 * it under the terms of the GNU General Public License version 2 as
 * published by the Free Software Foundation.
 */

#include "imx6d-sabresd.dts"

&mxcfb1 {
	compatible = "fsl,mxc_sdc_fb";
	disp_dev = "lcd";
	interface_pix_fmt = "RGB565";
	mode_str ="CLAA-WVGA";
	default_bpp = <32>;
	int_clk = <0>;
	late_init = <1>;
	fb_base = <0x18800000>;  /* Frame buffer base address, it is same as CONFIG_FB_BASE in Uboot. */
	fb_size = <0x01800000>;  /* Reserved display memory size, bigger than 3 x framer buffer size. */
	status = "okay";
};

&mxclcd0 {
	ipu_id = <0>;
	disp_id = <0>;
	status = "okay";
};

&ipu1 {
	bypass_reset = <1>;
	status = "okay";
};

