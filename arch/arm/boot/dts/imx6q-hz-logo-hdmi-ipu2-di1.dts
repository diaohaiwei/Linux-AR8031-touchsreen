/*
 * Copyright (C) 2015 Freescale Semiconductor, Inc.
 *
 * This program is free software; you can redistribute it and/or modify
 * it under the terms of the GNU General Public License version 2 as
 * published by the Free Software Foundation.
 */

//#include "imx6q-sabresd.dts"
#include "imx6q-hz.dts"

&mxcfb1 {
	compatible = "fsl,mxc_sdc_fb";
	disp_dev = "hdmi";
	interface_pix_fmt = "RGB24";
	mode_str ="1920x1080M@60";
	default_bpp = <32>;
	int_clk = <0>;
	late_init = <1>;
	fb_base = <0x18800000>;  /* Frame buffer base address, it is same as CONFIG_FB_BASE in Uboot. */
	fb_size = <0x01800000>;  /* Reserved display memory size, bigger than 3 x framer buffer size. */
	status = "okay";
};

&hdmi_core {
	ipu_id = <1>;
	disp_id = <1>;
	status = "okay";
};

&ipu1 {
	bypass_reset = <0>;
	status = "okay";
};

&ipu2 {
	bypass_reset = <1>;
	status = "okay";
};
