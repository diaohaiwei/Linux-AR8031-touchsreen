## drivers/media/ept/Kconfig
```kconfig
menu "EPT camera support"
config MXC_CAMERA_OV5640
        tristate "OmniVision ov5640 camera support"
        depends on !VIDEO_MXC_EMMA_CAMERA && I2C
        ---help---
          If you plan to use the ov5640 Camera with your MXC system, say Y here.

config MXC_CAMERA_OV5642
	tristate "OmniVision ov5642 camera support"
	depends on !VIDEO_MXC_EMMA_CAMERA && I2C
	---help---
	  If you plan to use the ov5642 Camera with your MXC system, say Y here.

config MXC_CAMERA_OV5640_MIPI
	tristate "OmniVision ov5640 camera support using mipi"
	depends on !VIDEO_MXC_EMMA_CAMERA && I2C
	---help---
	  If you plan to use the ov5640 Camera with mipi interface in your MXC system, say Y here.

config MXC_TVIN_ADV7180
	tristate "Analog Device adv7180 TV Decoder Input support"
	depends on !VIDEO_MXC_EMMA_CAMERA && I2C
	---help---
	  If you plan to use the adv7180 video decoder with your MXC system, say Y here.

config MXC_TVIN_ADV7280
	tristate "Analog Device adv7280 TV Decoder Input support"
	depends on !VIDEO_MXC_EMMA_CAMERA && I2C
	---help---
	  If you plan to use the adv7280 video decoder with your MXC system, say Y here.

config MXC_TVIN_ADV7283
	tristate "Analog Device adv7283 TV Decoder Input support"
	depends on !VIDEO_MXC_EMMA_CAMERA && I2C
	---help---
	  If you plan to use the adv7283 video decoder with your MXC system, say Y here.


endmenu
```
